## config/boards/shields/skeletyl/Kconfig.defconfig
```kconfig
if SHIELD_ENKI42_DONGLE

config ZMK_KEYBOARD_NAME
	default "Skeletyl"
	
config ZMK_SPLIT_BLE_ROLE_CENTRAL
	default y
	
config ZMK_USB
	default y

config ZMK_SPLIT_BLE_CENTRAL_PERIPHERALS
    default 2

endif

if SHIELD_SKELETYL_LEFT || SHIELD_SKELETYL_RIGHT || SHIELD_SKELETYL_DONGLE

config ZMK_SPLIT
    default y

config ZMK_BLE
    default y

endif
```
